## west.yml
```yaml
# Copyright (c) 2021 Nordic Semiconductor ASA
# SPDX-License-Identifier: Apache-2.0

manifest:
  remotes:
    - name: zephyrproject-rtos
      url-base: https://github.com/zephyrproject-rtos

  projects:
    - name: zephyr
      remote: zephyrproject-rtos
      revision: b08ea667c013a4f417f55de2cc2fc0e5bb5fec03
      import:
        name-allowlist:
          - mbedtls
          - net-tools
          - picolibc
```
