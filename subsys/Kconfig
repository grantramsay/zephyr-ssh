## subsys/net/Kconfig
```kconfig
# SPDX-License-Identifier: Apache-2.0

if NETWORKING

rsource "lib/Kconfig"

endif
```

## subsys/net/lib/ssh/Kconfig
```kconfig
# SPDX-License-Identifier: Apache-2.0

config SSH_SERVER
	bool "SSH Server [EXPERIMENTAL]"
	depends on NET_TCP && NET_SOCKETS && MBEDTLS
	select EXPERIMENTAL
	select ZVFS
    select ZVFS_EVENTFD
    select RING_BUFFER
	help
	  SSH-2 server support.

config SSH_CLIENT
	bool "SSH client [EXPERIMENTAL]"
	depends on NET_TCP && NET_SOCKETS && MBEDTLS
	select EXPERIMENTAL
	select ZVFS
    select ZVFS_EVENTFD
    select RING_BUFFER
	help
	  SSH-2 client support.

if SSH_SERVER

config SSH_SERVER_MAX_SERVERS
    int "SSH Server max instances"
    default 1

config SSH_SERVER_MAX_CLIENTS
    int "SSH Server max clients (per server)"
    default 1

endif

if SSH_CLIENT

config SSH_CLIENT_MAX_CLIENTS
    int "SSH Client max instances"
    default 1

endif

if SSH

config SSH_MAX_CHANNELS
    int "SSH max channels (per transport)"
    default 1

config SSH_CHANNEL_BUF_SIZE
    int "SSH channel buffer size"
    default 256

config SSH_MAX_HOST_KEYS
    int "SSH keygen max host keys"
    default 1

config SSH_HOST_KEY_RSA
    bool "Enable RSA host key support"
    default y

config SSH_HOST_KEY_ALG_RSA_SHA2_256
    bool "Enable rsa-sha2-256 host key algorithm"
    default y
config SSH_HOST_KEY_ALG_RSA_SHA2_512
    bool "Enable rsa-sha2-512 host key algorithm"

endif

# Hidden option to avoid having multiple individual options that are ORed together
config SSH
	bool
	depends on (SSH_SERVER || SSH_CLIENT)
	default y

config SSH_IDENTITY_OVERRIDE_ENABLE
    bool "Override the default SSH identity (useful for testing)"

config SSH_IDENTITY_OVERRIDE
    string "SSH identity override"
    depends on SSH_IDENTITY_OVERRIDE_ENABLE

module = NET_SSH
module-dep = NET_LOG
module-str = Log level for SSH library
module-help = Enables SSH code to output debug messages.
source "subsys/net/Kconfig.template.log_config.net"
```
