## CMakeLists.txt
```
# Copyright (c) 2021, Legrand North America, LLC.
# SPDX-License-Identifier: Apache-2.0

cmake_minimum_required(VERSION 3.20.0)
find_package(Zephyr REQUIRED HINTS $ENV{ZEPHYR_BASE})
project(ssh_pkt_test)

target_sources(app PRIVATE src/main.c)

zephyr_include_directories(.)
```

## prj.conf
```kconfig
CONFIG_ZTEST=y

CONFIG_NO_OPTIMIZATIONS=y

CONFIG_SSH_SERVER=y
CONFIG_SSH_CLIENT=y
CONFIG_NET_SSH_LOG_LEVEL_DBG=y
CONFIG_SSH_SERVER_MAX_CLIENTS=2
CONFIG_SSH_IDENTITY_OVERRIDE_ENABLE=y
CONFIG_SSH_IDENTITY_OVERRIDE="SSH-2.0-zephyr"

CONFIG_MBEDTLS=y
CONFIG_MBEDTLS_BUILTIN=y

CONFIG_CUSTOM_MBEDTLS_CFG_FILE=y
CONFIG_MBEDTLS_CFG_FILE="mbedtls-config-ssh.h"

CONFIG_NET_TEST=y




CONFIG_ENTROPY_GENERATOR=y
CONFIG_TEST_RANDOM_GENERATOR=y
CONFIG_ZTEST_STACK_SIZE=1024

CONFIG_ZVFS_OPEN_MAX=10
CONFIG_REQUIRES_FULL_LIBC=y
CONFIG_ZVFS_EVENTFD_MAX=10
CONFIG_NET_MAX_CONTEXTS=10
CONFIG_NET_MAX_CONN=10

# Networking config
CONFIG_NETWORKING=y
CONFIG_NET_IPV4=y
CONFIG_NET_IPV6=y
CONFIG_NET_TCP=y
CONFIG_NET_SOCKETS=y
CONFIG_NET_LOOPBACK=y
CONFIG_NET_LOOPBACK_MTU=1280
CONFIG_NET_DRIVERS=y
CONFIG_NET_SOCKETS_POLL_MAX=8
CONFIG_NET_BUF_RX_COUNT=32
CONFIG_NET_BUF_TX_COUNT=32
CONFIG_NET_PKT_RX_COUNT=16
CONFIG_NET_PKT_TX_COUNT=16

# Reduce the retry count, so the close always finishes within a second
CONFIG_NET_TCP_RETRY_COUNT=3
CONFIG_NET_TCP_INIT_RETRANSMISSION_TIMEOUT=120

# Network address config
CONFIG_NET_CONFIG_SETTINGS=n

CONFIG_MAIN_STACK_SIZE=2048

# Network debug config
CONFIG_NET_LOG=y
```

## src/main.c
```c
/*
* Copyright (c) 2024 Grant Ramsay <grant.ramsay@hotmail.com>
*
* SPDX-License-Identifier: Apache-2.0
*/

#include <zephyr/net/socket.h>
#include <zephyr/ztest.h>

#include <zephyr/net/ssh/client.h>
#include <zephyr/net/ssh/keygen.h>
#include <zephyr/net/ssh/server.h>

#define MY_IPV4_ADDR "127.0.0.1"
#define SSH_PORT 22

// TODO: Overwrite random functions to completely remove entropy?
//void z_impl_sys_rand_get(void *dst, size_t outlen)
//{
//	memset(dst, 0xAA, outlen);
//}
//int z_impl_sys_csrand_get(void *dst, size_t outlen)
//{
//	memset(dst, 0xAA, outlen);
//	return 0;
//}

static int ssh_server_event_callback(struct ssh_server *ssh_server, const struct ssh_server_event *event, void *user_data)
{
	return 0;
}

static int ssh_server_transport_event_callback(struct ssh_transport *transport, const struct ssh_transport_event *event, void *user_data)
{
	return 0;
}

static void test_ssh_server(void)
{
	int ret, recv_len;
	int client_fd;
	char *ptr;
	size_t len;
	struct sockaddr_in sa;
	static unsigned char buf[4096];

	int host_key_index = 0;
	uint16_t key_size_bits = 2048;
	zassert_ok(ssh_keygen(host_key_index, SSH_HOST_KEY_TYPE_RSA, key_size_bits),
		   "Failed to generate server host key");

	struct sockaddr_in bind_addr;
	bind_addr.sin_family = AF_INET;
	bind_addr.sin_port = htons(SSH_PORT);
	zsock_inet_pton(AF_INET, MY_IPV4_ADDR, &bind_addr.sin_addr);

	struct ssh_server *ssh_server = ssh_server_instance(0);
	zassert_not_null(ssh_server);

	int *authorized_keys = NULL;
	zassert_ok(ssh_server_start(ssh_server, &bind_addr, host_key_index,
				    authorized_keys, 0, ssh_server_event_callback,
				    ssh_server_transport_event_callback, NULL),
		   "Failed to start the server");

	k_sleep(K_MSEC(1));

	ret = zsock_socket(AF_INET, SOCK_STREAM, IPPROTO_TCP);
	zassert_not_equal(ret, -1, "failed to create client socket (%d)", errno);
	client_fd = ret;

	sa.sin_family = AF_INET;
	sa.sin_port = htons(SSH_PORT);

	ret = zsock_inet_pton(AF_INET, MY_IPV4_ADDR, &sa.sin_addr.s_addr);
	zassert_not_equal(-1, ret, "inet_pton() failed (%d)", errno);
	zassert_not_equal(0, ret, "%s is not a valid IPv4 address", MY_IPV4_ADDR);
	zassert_equal(1, ret, "inet_pton() failed to convert %s", MY_IPV4_ADDR);

	memset(buf, '\0', sizeof(buf));
	ptr = (char *)zsock_inet_ntop(AF_INET, &sa.sin_addr, buf, sizeof(buf));
	zassert_not_equal(ptr, NULL, "inet_ntop() failed (%d)", errno);

	ret = zsock_connect(client_fd, (struct sockaddr *)&sa, sizeof(sa));
	zassert_not_equal(ret, -1, "failed to connect (%s/%d)", strerror(errno), errno);

	// Receive server identity
	const char *expected_identity = "SSH-2.0-zephyr\r\n";
	len = strlen(expected_identity);
	recv_len = 0;
	while (recv_len < len) {
		ret = zsock_recv(client_fd, buf + recv_len, sizeof(buf) - recv_len, 0);
		zassert_not_equal(ret, -1, "recv() failed (%d)", errno);

		recv_len += ret;
	}
	buf[recv_len] = '\0';
	zassert_str_equal(expected_identity, buf, "Incorrect server identity");

	// Send client identity
	const char *test_identity = "SSH-2.0-ztest\r\n";
	ret = zsock_send(client_fd, test_identity, strlen(test_identity), 0);
	zassert_not_equal(ret, -1, "send() failed (%d)", errno);

	// Receive server kexinit
	const uint8_t expected_kexinit[] = {
		0x00, 0x00, 0x00, 0x9c, 0x0a, 0x14, 0xab, 0x3e, 0x47, 0x18, 0x0e, 0x36, 0xee, 0x56, 0x99, 0xec,
		0xe5, 0x0c, 0xfa, 0xf2, 0x8c, 0x5b, 0x00, 0x00, 0x00, 0x11, 0x63, 0x75, 0x72, 0x76, 0x65, 0x32,
		0x35, 0x35, 0x31, 0x39, 0x2d, 0x73, 0x68, 0x61, 0x32, 0x35, 0x36, 0x00, 0x00, 0x00, 0x0c, 0x72,
		0x73, 0x61, 0x2d, 0x73, 0x68, 0x61, 0x32, 0x2d, 0x32, 0x35, 0x36, 0x00, 0x00, 0x00, 0x0a, 0x61,
		0x65, 0x73, 0x31, 0x32, 0x38, 0x2d, 0x63, 0x74, 0x72, 0x00, 0x00, 0x00, 0x0a, 0x61, 0x65, 0x73,
		0x31, 0x32, 0x38, 0x2d, 0x63, 0x74, 0x72, 0x00, 0x00, 0x00, 0x0d, 0x68, 0x6d, 0x61, 0x63, 0x2d,
		0x73, 0x68, 0x61, 0x32, 0x2d, 0x32, 0x35, 0x36, 0x00, 0x00, 0x00, 0x0d, 0x68, 0x6d, 0x61, 0x63,
		0x2d, 0x73, 0x68, 0x61, 0x32, 0x2d, 0x32, 0x35, 0x36, 0x00, 0x00, 0x00, 0x04, 0x6e, 0x6f, 0x6e,
		0x65, 0x00, 0x00, 0x00, 0x04, 0x6e, 0x6f, 0x6e, 0x65, 0x00, 0x00, 0x00, 0x00, 0x00, 0x00, 0x00,
		0x00, 0x00, 0x00, 0x00, 0x00, 0x00, 0x03, 0x71, 0x80, 0x20, 0x94, 0xbf, 0xb8, 0x3b, 0xef, 0x51
	};
	recv_len = 0;
	while (recv_len < sizeof(expected_kexinit)) {
		ret = zsock_recv(client_fd, buf + recv_len, sizeof(buf) - recv_len, 0);
		zassert_not_equal(ret, -1, "recv() failed (%d)", errno);

		recv_len += ret;
	}
	zassert_mem_equal(expected_kexinit, buf, sizeof(expected_kexinit), "Incorrect server kexinit");

	// Send client kexinit
	ret = zsock_send(client_fd, expected_kexinit, sizeof(expected_kexinit), 0);
	zassert_not_equal(ret, -1, "send() failed (%d)", errno);

	// Send client kex ecdh init
	const uint8_t client_kex_ecdh_init[] = {
		0x00, 0x00, 0x00, 0x2c, 0x06, 0x1e, 0x00, 0x00, 0x00, 0x20, 0x20, 0x3d, 0x64, 0x36, 0xd4, 0x4a,
		0x9b, 0xd2, 0x14, 0x18, 0x64, 0x3e, 0xaf, 0x85, 0xad, 0x24, 0x0c, 0x8b, 0x4e, 0x89, 0x40, 0xef,
		0xff, 0x05, 0x88, 0x01, 0x58, 0x0a, 0xbb, 0xa8, 0x4f, 0x37, 0xa2, 0xac, 0xf8, 0x14, 0xfd, 0x71
	};
	ret = zsock_send(client_fd, client_kex_ecdh_init, sizeof(client_kex_ecdh_init), 0);
	zassert_not_equal(ret, -1, "send() failed (%d)", errno);

	// Receive server kex ecdh reply
	const uint8_t expected_kex_ecdh_reply[] = {
		0x00, 0x00, 0x02, 0x64, 0x0b, 0x1f, 0x00, 0x00, 0x01, 0x17, 0x00, 0x00, 0x00, 0x07, 0x73, 0x73,
		0x68, 0x2d, 0x72, 0x73, 0x61, 0x00, 0x00, 0x00, 0x03, 0x01, 0x00, 0x01, 0x00, 0x00, 0x01, 0x01,
		0x00, 0x96, 0x0b, 0x07, 0xbc, 0x1a, 0xaa, 0x5a, 0x2b, 0x92, 0x5f, 0x50, 0x5f, 0x9d, 0xfa, 0xb2,
		0x13, 0x29, 0x2b, 0x2a, 0xd2, 0x3b, 0xd7, 0xbc, 0xcc, 0x69, 0x5f, 0xa4, 0xc9, 0x47, 0x16, 0x3d,
		0xcf, 0xc4, 0x10, 0x94, 0xb7, 0x06, 0x05, 0x42, 0x53, 0x76, 0xd0, 0x65, 0x5f, 0x95, 0x11, 0xff,
		0x61, 0x77, 0x93, 0x7f, 0xb5, 0x47, 0xf3, 0x6b, 0x48, 0xc7, 0xdd, 0x40, 0x69, 0x82, 0xf4, 0x48,
		0xc8, 0xf0, 0x56, 0x60, 0xc8, 0x13, 0x2d, 0xf3, 0x40, 0x28, 0x31, 0xfd, 0x40, 0xc5, 0xff, 0xf1,
		0x79, 0x56, 0x06, 0x21, 0x95, 0x6d, 0xd5, 0x07, 0x13, 0x58, 0x8c, 0x7b, 0xc8, 0x62, 0xf2, 0xc3,
		0xa9, 0xb8, 0xb6, 0x0e, 0x69, 0xe4, 0xf3, 0x94, 0x0f, 0x18, 0x6e, 0x3b, 0xea, 0x18, 0x9b, 0xdb,
		0x46, 0xfe, 0xe1, 0x40, 0x36, 0x5f, 0xf2, 0xdf, 0xe0, 0xb1, 0xd6, 0xcf, 0xf1, 0x32, 0x77, 0x46,
		0x0a, 0x90, 0xa3, 0xed, 0x90, 0xe9, 0xd4, 0x44, 0xa3, 0xa2, 0xe7, 0x57, 0x01, 0xb1, 0x06, 0x06,
		0x17, 0x1f, 0xf9, 0xfd, 0xf8, 0x4c, 0xdf, 0xa9, 0x24, 0xaf, 0x5f, 0x44, 0x2b, 0x86, 0x2b, 0x2f,
		0xc3, 0xfe, 0x41, 0xf4, 0x95, 0x28, 0xbf, 0xd7, 0xb2, 0xc3, 0xc2, 0xb2, 0x8a, 0x1f, 0x22, 0x68,
		0x02, 0xb4, 0x92, 0xdc, 0x4e, 0x8b, 0x2d, 0x0c, 0x53, 0xe7, 0xe6, 0xf6, 0x4d, 0x68, 0x0a, 0xa1,
		0x61, 0xc5, 0xb7, 0x65, 0xe4, 0xe1, 0x36, 0x8b, 0xc5, 0x35, 0xd9, 0x93, 0x87, 0x79, 0x47, 0xc1,
		0xdf, 0x01, 0x12, 0xd1, 0x7f, 0x36, 0x9e, 0x0f, 0x3d, 0x1a, 0xaf, 0xdf, 0x24, 0xd3, 0xf0, 0x2f,
		0xf0, 0xd4, 0x38, 0xdd, 0xae, 0x8c, 0xf4, 0x4d, 0xab, 0x4c, 0x3f, 0x69, 0x7f, 0x07, 0x72, 0xe3,
		0x9b, 0x0c, 0xa8, 0xe1, 0x0f, 0xb8, 0x56, 0xa5, 0x5e, 0xee, 0xae, 0x7b, 0x4d, 0xf5, 0x34, 0x02,
		0xdf, 0x00, 0x00, 0x00, 0x20, 0x09, 0x08, 0x6a, 0x7b, 0x0c, 0x15, 0x81, 0x3f, 0x8e, 0x57, 0x40,
		0x01, 0xd3, 0xec, 0x88, 0xce, 0x31, 0x98, 0x4d, 0x29, 0x53, 0x66, 0x79, 0x85, 0x94, 0x6f, 0xf5,
		0x08, 0xd6, 0xd6, 0xec, 0x62, 0x00, 0x00, 0x01, 0x14, 0x00, 0x00, 0x00, 0x0c, 0x72, 0x73, 0x61,
		0x2d, 0x73, 0x68, 0x61, 0x32, 0x2d, 0x32, 0x35, 0x36, 0x00, 0x00, 0x01, 0x00, 0x18, 0x0a, 0xef,
		0x88, 0x40, 0x0a, 0xa0, 0x8c, 0x4d, 0xd0, 0xb7, 0xda, 0xad, 0xba, 0xc5, 0x5d, 0x76, 0xba, 0xa0,
		0xdf, 0xbb, 0x75, 0xa5, 0xea, 0x34, 0x53, 0x3a, 0x93, 0x9c, 0x11, 0x32, 0x0e, 0x3b, 0xad, 0xcc,
		0x60, 0xd8, 0xc5, 0x54, 0xd2, 0x67, 0x5d, 0x04, 0x7d, 0xd7, 0x19, 0xa9, 0x02, 0xf0, 0x32, 0x89,
		0x8e, 0xd0, 0x6c, 0x7f, 0x34, 0x1c, 0x87, 0xcd, 0xd3, 0x9a, 0xd1, 0x87, 0x6d, 0xde, 0x40, 0x5c,
		0x79, 0x17, 0x48, 0xf5, 0x67, 0x19, 0xef, 0x3b, 0x28, 0x49, 0x83, 0xb9, 0x32, 0xb1, 0x05, 0x82,
		0xc7, 0x7e, 0xad, 0x55, 0xc1, 0xc9, 0x6b, 0x00, 0x2e, 0x72, 0xca, 0xf2, 0xf0, 0xbf, 0x2d, 0x3f,
		0xd5, 0xfe, 0x04, 0x1f, 0xa9, 0xce, 0xb1, 0x6b, 0xad, 0xf7, 0x92, 0xef, 0xe2, 0x8a, 0x40, 0x57,
		0x50, 0x76, 0xb2, 0x1c, 0xea, 0x21, 0xb0, 0x96, 0x05, 0x65, 0xa5, 0xb7, 0x56, 0xbc, 0xb1, 0xae,
		0xae, 0x54, 0x1b, 0x13, 0xd3, 0x3e, 0xe6, 0xfa, 0x24, 0x60, 0xd8, 0x37, 0x9c, 0xb9, 0xa4, 0x34,
		0x24, 0x2b, 0xad, 0x6a, 0xe4, 0xed, 0x53, 0xc7, 0x28, 0xe0, 0xe6, 0x35, 0x32, 0x9c, 0xe0, 0x27,
		0x9c, 0x89, 0x18, 0x7d, 0x3b, 0x82, 0x02, 0xfc, 0x9f, 0x41, 0x09, 0x75, 0xa3, 0xe7, 0x0a, 0x31,
		0x73, 0xb1, 0xca, 0x13, 0x45, 0x2b, 0x60, 0x7c, 0x42, 0x92, 0x58, 0x3b, 0x9f, 0xe5, 0xef, 0x6c,
		0x3c, 0xa8, 0x09, 0x47, 0x90, 0x64, 0xa6, 0xf5, 0xa2, 0x4d, 0x0b, 0x38, 0xb0, 0xbc, 0x88, 0x61,
		0x7b, 0x8b, 0x28, 0x57, 0x18, 0x93, 0xda, 0xe3, 0x8a, 0x25, 0x49, 0x95, 0xa7, 0x79, 0x00, 0x0c,
		0xbc, 0x23, 0x2c, 0x95, 0xb8, 0xca, 0x63, 0x02, 0x23, 0x2b, 0x7d, 0x80, 0xf6, 0x58, 0x23, 0x8e,
		0x33, 0xaf, 0x76, 0x99, 0x96, 0x64, 0xe3, 0x9d, 0x8b, 0x49, 0x43, 0x28, 0x00, 0x1c, 0xc0, 0xa8,
		0x6b, 0x1b, 0xa8, 0x4d, 0x30, 0x7e, 0xe0, 0xff
	};
	recv_len = 0;
	while (recv_len < sizeof(expected_kex_ecdh_reply)) {
		ret = zsock_recv(client_fd, buf + recv_len, sizeof(buf) - recv_len, 0);
		zassert_not_equal(ret, -1, "recv() failed (%d)", errno);

		recv_len += ret;
	}
	zassert_mem_equal(expected_kex_ecdh_reply, buf, sizeof(expected_kex_ecdh_reply), "Incorrect server kex ecdh reply");

	// Receive server newkeys
	const uint8_t expected_newkeys[] = {
		0x00, 0x00, 0x00, 0x0c, 0x0a, 0x15, 0xb5, 0x05, 0x05, 0x56, 0x40, 0x9f, 0xd4, 0x62, 0x82, 0xb3
	};
	recv_len = 0;
	while (recv_len < sizeof(expected_newkeys)) {
		ret = zsock_recv(client_fd, buf + recv_len, sizeof(buf) - recv_len, 0);
		zassert_not_equal(ret, -1, "recv() failed (%d)", errno);

		recv_len += ret;
	}
	zassert_mem_equal(expected_newkeys, buf, sizeof(expected_newkeys), "Incorrect server newkeys");

	// Send client newkeys
	ret = zsock_send(client_fd, expected_newkeys, sizeof(expected_newkeys), 0);
	zassert_not_equal(ret, -1, "send() failed (%d)", errno);

	k_sleep(K_SECONDS(1));

	zassert_ok(ssh_server_stop(ssh_server), "Failed to stop the server");

	k_sleep(K_SECONDS(1));
}

ZTEST(ssh_server, test_ssh_server)
{
	test_ssh_server();
}

ZTEST_SUITE(ssh_server, NULL, NULL, NULL, NULL, NULL);
```
