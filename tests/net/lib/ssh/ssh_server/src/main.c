/*
* Copyright (c) 2024 Grant Ramsay <grant.ramsay@hotmail.com>
*
* SPDX-License-Identifier: Apache-2.0
*/

#include <zephyr/net/socket.h>
#include <zephyr/ztest.h>

#include <zephyr/net/ssh/client.h>
#include <zephyr/net/ssh/keygen.h>
#include <zephyr/net/ssh/server.h>

#define MY_IPV4_ADDR "127.0.0.1"
#define SSH_PORT 22

// TODO: Overwrite random functions to completely remove entropy?
//void z_impl_sys_rand_get(void *dst, size_t outlen)
//{
//	memset(dst, 0xAA, outlen);
//}
//int z_impl_sys_csrand_get(void *dst, size_t outlen)
//{
//	memset(dst, 0xAA, outlen);
//	return 0;
//}

static int ssh_server_event_callback(struct ssh_server *ssh_server, const struct ssh_server_event *event, void *user_data)
{
	return 0;
}

static int ssh_server_transport_event_callback(struct ssh_transport *transport, const struct ssh_transport_event *event, void *user_data)
{
	return 0;
}

static void test_ssh_server(void)
{
	int ret, recv_len;
	int client_fd;
	char *ptr;
	size_t len;
	struct sockaddr_in sa;
	static unsigned char buf[4096];

	int host_key_index = 0;
	uint16_t key_size_bits = 2048;
	zassert_ok(ssh_keygen(host_key_index, SSH_HOST_KEY_TYPE_RSA, key_size_bits),
		   "Failed to generate server host key");

	struct sockaddr_in bind_addr;
	bind_addr.sin_family = AF_INET;
	bind_addr.sin_port = htons(SSH_PORT);
	zsock_inet_pton(AF_INET, MY_IPV4_ADDR, &bind_addr.sin_addr);

	struct ssh_server *ssh_server = ssh_server_instance(0);
	zassert_not_null(ssh_server);

	int *authorized_keys = NULL;
	zassert_ok(ssh_server_start(ssh_server, &bind_addr, host_key_index,
				    authorized_keys, 0, ssh_server_event_callback,
				    ssh_server_transport_event_callback, NULL),
		   "Failed to start the server");

	k_sleep(K_MSEC(1));

	ret = zsock_socket(AF_INET, SOCK_STREAM, IPPROTO_TCP);
	zassert_not_equal(ret, -1, "failed to create client socket (%d)", errno);
	client_fd = ret;

	sa.sin_family = AF_INET;
	sa.sin_port = htons(SSH_PORT);

	ret = zsock_inet_pton(AF_INET, MY_IPV4_ADDR, &sa.sin_addr.s_addr);
	zassert_not_equal(-1, ret, "inet_pton() failed (%d)", errno);
	zassert_not_equal(0, ret, "%s is not a valid IPv4 address", MY_IPV4_ADDR);
	zassert_equal(1, ret, "inet_pton() failed to convert %s", MY_IPV4_ADDR);

	memset(buf, '\0', sizeof(buf));
	ptr = (char *)zsock_inet_ntop(AF_INET, &sa.sin_addr, buf, sizeof(buf));
	zassert_not_equal(ptr, NULL, "inet_ntop() failed (%d)", errno);

	ret = zsock_connect(client_fd, (struct sockaddr *)&sa, sizeof(sa));
	zassert_not_equal(ret, -1, "failed to connect (%s/%d)", strerror(errno), errno);

	// Receive server identity
	const char *expected_identity = "SSH-2.0-zephyr\r\n";
	len = strlen(expected_identity);
	recv_len = 0;
	while (recv_len < len) {
		ret = zsock_recv(client_fd, buf + recv_len, sizeof(buf) - recv_len, 0);
		zassert_not_equal(ret, -1, "recv() failed (%d)", errno);

		recv_len += ret;
	}
	buf[recv_len] = '\0';
	zassert_str_equal(expected_identity, buf, "Incorrect server identity");

	// Send client identity
	const char *test_identity = "SSH-2.0-ztest\r\n";
	ret = zsock_send(client_fd, test_identity, strlen(test_identity), 0);
	zassert_not_equal(ret, -1, "send() failed (%d)", errno);

	// Receive server kexinit
	const uint8_t expected_kexinit[] = {
		0x00, 0x00, 0x00, 0x9c, 0x0a, 0x14, 0xab, 0x3e, 0x47, 0x18, 0x0e, 0x36, 0xee, 0x56, 0x99, 0xec,
		0xe5, 0x0c, 0xfa, 0xf2, 0x8c, 0x5b, 0x00, 0x00, 0x00, 0x11, 0x63, 0x75, 0x72, 0x76, 0x65, 0x32,
		0x35, 0x35, 0x31, 0x39, 0x2d, 0x73, 0x68, 0x61, 0x32, 0x35, 0x36, 0x00, 0x00, 0x00, 0x0c, 0x72,
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		0x00, 0x00, 0x00, 0x00, 0x00, 0x00, 0x03, 0x71, 0x80, 0x20, 0x94, 0xbf, 0xb8, 0x3b, 0xef, 0x51
	};
	recv_len = 0;
	while (recv_len < sizeof(expected_kexinit)) {
		ret = zsock_recv(client_fd, buf + recv_len, sizeof(buf) - recv_len, 0);
		zassert_not_equal(ret, -1, "recv() failed (%d)", errno);

		recv_len += ret;
	}
	zassert_mem_equal(expected_kexinit, buf, sizeof(expected_kexinit), "Incorrect server kexinit");

	// Send client kexinit
	ret = zsock_send(client_fd, expected_kexinit, sizeof(expected_kexinit), 0);
	zassert_not_equal(ret, -1, "send() failed (%d)", errno);

	// Send client kex ecdh init
	const uint8_t client_kex_ecdh_init[] = {
		0x00, 0x00, 0x00, 0x2c, 0x06, 0x1e, 0x00, 0x00, 0x00, 0x20, 0x20, 0x3d, 0x64, 0x36, 0xd4, 0x4a,
		0x9b, 0xd2, 0x14, 0x18, 0x64, 0x3e, 0xaf, 0x85, 0xad, 0x24, 0x0c, 0x8b, 0x4e, 0x89, 0x40, 0xef,
		0xff, 0x05, 0x88, 0x01, 0x58, 0x0a, 0xbb, 0xa8, 0x4f, 0x37, 0xa2, 0xac, 0xf8, 0x14, 0xfd, 0x71
	};
	ret = zsock_send(client_fd, client_kex_ecdh_init, sizeof(client_kex_ecdh_init), 0);
	zassert_not_equal(ret, -1, "send() failed (%d)", errno);

	// Receive server kex ecdh reply
	const uint8_t expected_kex_ecdh_reply[] = {
		0x00, 0x00, 0x02, 0x64, 0x0b, 0x1f, 0x00, 0x00, 0x01, 0x17, 0x00, 0x00, 0x00, 0x07, 0x73, 0x73,
		0x68, 0x2d, 0x72, 0x73, 0x61, 0x00, 0x00, 0x00, 0x03, 0x01, 0x00, 0x01, 0x00, 0x00, 0x01, 0x01,
		0x00, 0x96, 0x0b, 0x07, 0xbc, 0x1a, 0xaa, 0x5a, 0x2b, 0x92, 0x5f, 0x50, 0x5f, 0x9d, 0xfa, 0xb2,
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		0x6b, 0x1b, 0xa8, 0x4d, 0x30, 0x7e, 0xe0, 0xff
	};
	recv_len = 0;
	while (recv_len < sizeof(expected_kex_ecdh_reply)) {
		ret = zsock_recv(client_fd, buf + recv_len, sizeof(buf) - recv_len, 0);
		zassert_not_equal(ret, -1, "recv() failed (%d)", errno);

		recv_len += ret;
	}
	zassert_mem_equal(expected_kex_ecdh_reply, buf, sizeof(expected_kex_ecdh_reply), "Incorrect server kex ecdh reply");

	// Receive server newkeys
	const uint8_t expected_newkeys[] = {
		0x00, 0x00, 0x00, 0x0c, 0x0a, 0x15, 0xb5, 0x05, 0x05, 0x56, 0x40, 0x9f, 0xd4, 0x62, 0x82, 0xb3
	};
	recv_len = 0;
	while (recv_len < sizeof(expected_newkeys)) {
		ret = zsock_recv(client_fd, buf + recv_len, sizeof(buf) - recv_len, 0);
		zassert_not_equal(ret, -1, "recv() failed (%d)", errno);

		recv_len += ret;
	}
	zassert_mem_equal(expected_newkeys, buf, sizeof(expected_newkeys), "Incorrect server newkeys");

	// Send client newkeys
	ret = zsock_send(client_fd, expected_newkeys, sizeof(expected_newkeys), 0);
	zassert_not_equal(ret, -1, "send() failed (%d)", errno);

	k_sleep(K_SECONDS(1));

	zassert_ok(ssh_server_stop(ssh_server), "Failed to stop the server");

	k_sleep(K_SECONDS(1));
}

ZTEST(ssh_server, test_ssh_server)
{
	test_ssh_server();
}

ZTEST_SUITE(ssh_server, NULL, NULL, NULL, NULL, NULL);
