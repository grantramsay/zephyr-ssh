## CMakeLists.txt
```
# SPDX-License-Identifier: Apache-2.0

cmake_minimum_required(VERSION 3.20.0)

find_package(Zephyr REQUIRED HINTS $ENV{ZEPHYR_BASE})
project(ssh)

target_sources(app PRIVATE src/main.c)

zephyr_include_directories(.)
```

## prj.conf
```kconfig
CONFIG_NO_OPTIMIZATIONS=y
CONFIG_SYS_CLOCK_TICKS_PER_SEC=1000
CONFIG_NATIVE_SIM_SLOWDOWN_TO_REAL_TIME=y

# Generic networking options
CONFIG_NETWORKING=y
CONFIG_NET_UDP=y
CONFIG_NET_TCP=y
CONFIG_NET_IPV6=y
CONFIG_NET_IPV4=y
CONFIG_NET_SOCKETS=y

CONFIG_NET_CONNECTION_MANAGER=y

# Kernel options
CONFIG_MAIN_STACK_SIZE=2048
CONFIG_ENTROPY_GENERATOR=y
CONFIG_TEST_RANDOM_GENERATOR=y
CONFIG_INIT_STACKS=y

# Logging
CONFIG_NET_LOG=y
CONFIG_LOG=y
CONFIG_NET_STATISTICS=y
CONFIG_PRINTK=y

# Network buffers
CONFIG_NET_PKT_RX_COUNT=16
CONFIG_NET_PKT_TX_COUNT=16
CONFIG_NET_BUF_RX_COUNT=64
CONFIG_NET_BUF_TX_COUNT=64
CONFIG_NET_CONTEXT_NET_PKT_POOL=y

# IP address options
CONFIG_NET_IF_UNICAST_IPV6_ADDR_COUNT=3
CONFIG_NET_IF_MCAST_IPV6_ADDR_COUNT=4
CONFIG_NET_MAX_CONTEXTS=10

# Network shell
CONFIG_NET_SHELL=y
CONFIG_SHELL=y

# Network application options and configuration
CONFIG_NET_CONFIG_SETTINGS=y
CONFIG_NET_CONFIG_NEED_IPV6=y
CONFIG_NET_CONFIG_MY_IPV6_ADDR="2001:db8::1"
CONFIG_NET_CONFIG_PEER_IPV6_ADDR="2001:db8::2"
CONFIG_NET_CONFIG_NEED_IPV4=y
CONFIG_NET_CONFIG_MY_IPV4_ADDR="192.0.2.1"
CONFIG_NET_CONFIG_PEER_IPV4_ADDR="192.0.2.2"

CONFIG_NET_SOCKETS_POLL_MAX=10

CONFIG_MBEDTLS=y
CONFIG_MBEDTLS_BUILTIN=y

CONFIG_CUSTOM_MBEDTLS_CFG_FILE=y
CONFIG_MBEDTLS_CFG_FILE="mbedtls-config-ssh.h"

CONFIG_SSH_SERVER=y
CONFIG_SSH_CLIENT=y
#CONFIG_NET_SSH_LOG_LEVEL_DBG=y
CONFIG_NET_SSH_LOG_LEVEL_INF=y
CONFIG_SSH_SERVER_MAX_CLIENTS=2
CONFIG_SSH_SERVER_SHELL_COUNT=2
CONFIG_SSH_MAX_CHANNELS=2
CONFIG_SSH_MAX_HOST_KEYS=4
#CONFIG_SSH_HOST_KEY_ALG_RSA_SHA2_512=y

CONFIG_ZVFS_OPEN_MAX=12
CONFIG_ZVFS_EVENTFD_MAX=4

CONFIG_SETTINGS=y
CONFIG_SETTINGS_NVS=y
CONFIG_NVS=y
CONFIG_FLASH=y
CONFIG_FLASH_MAP=y

# Should to be big enough to import a public key in PEM format
CONFIG_SHELL_BACKEND_SERIAL_RX_RING_BUFFER_SIZE=2048
```

## src/main.c
```c
/*
* Copyright (c) 2024 Grant Ramsay <grant.ramsay@hotmail.com>
*
* SPDX-License-Identifier: Apache-2.0
*/

#include <zephyr/kernel.h>

#include <zephyr/shell/shell_uart.h>

#include <zephyr/logging/log.h>
LOG_MODULE_REGISTER(ssh_sample, LOG_LEVEL_INF);


int main(void)
{
	LOG_INF("SSH sample %s", CONFIG_BOARD_TARGET);

#if 0 // Testing/development code to autorun some commands
	int res;
	const struct shell *sh = shell_backend_uart_get_ptr();

	res = shell_execute_cmd(sh, "ssh_key load 0 priv id_rsa");
	if (res != 0) {
		LOG_WRN("Could not load host key, generating new key pair...");
		res = shell_execute_cmd(sh, "ssh_key gen 0 rsa 2048");
		if (res != 0) {
			LOG_ERR("Failed to generate host key");
			return res;
		}
		(void)shell_execute_cmd(sh, "ssh_key save 0 priv id_rsa");
	}
	(void)shell_execute_cmd(sh, "ssh_key pub export 0");

	res = shell_execute_cmd(sh, "ssh_key load 1 pub authorized_key_0");
	if (res == 0) {
		(void)shell_execute_cmd(sh, "sshd start 0 192.0.2.1 0 password1 22 1");
	} else {
		(void)shell_execute_cmd(sh, "sshd start 0 192.0.2.1 0 password1");
	}

//	(void)shell_execute_cmd(sh, "ssh start 0 test-user@192.0.2.2");
	(void)shell_execute_cmd(sh, "ssh start 0 test-user@192.0.2.2 0 22");
#endif

	while (true) {
		k_sleep(K_FOREVER);
	}

	return 0;
}
```

## src/client.c
```c
/*
* Copyright (c) 2024 Grant Ramsay <grant.ramsay@hotmail.com>
*
* SPDX-License-Identifier: Apache-2.0
*/

#include <zephyr/kernel.h>
#include <zephyr/net/ssh/client.h>
#include <zephyr/shell/shell.h>

#include <zephyr/logging/log.h>
LOG_MODULE_DECLARE(ssh_sample, LOG_LEVEL_INF);

// TODO: Why isn't this in <string.h>?
char *strtok_r(char *str, const char *delim, char **saveptr);

#define DEFAULT_SSH_PORT 22

static int ssh_client_transport_event_callback(struct ssh_transport *transport, const struct ssh_transport_event *event, void *user_data);
static int ssh_client_channel_event_callback(struct ssh_channel *channel, const struct ssh_channel_event *event, void *user_data);

// TODO: Shell bypass could be done using a stack data structure
// For now it's just single instance and would break if bypassed multiple times
static struct ssh_transport *shell_bypass_ssh_transport = NULL;
static struct ssh_channel *shell_bypass_ssh_channel = NULL;
static uint8_t password_buff[32 + 1];
static int password_len = 0;

static void shell_bypass_password(const struct shell *sh, uint8_t *data, size_t len)
{
	while (len--) {
		uint8_t c = *data++;
		if (c == '\r' || c == '\n' || password_len >= sizeof(password_buff) - 1) {
			password_buff[password_len] = 0;
			shell_set_bypass(sh, NULL);
			struct ssh_transport *transport = shell_bypass_ssh_transport;
			if (transport != NULL) {
				const char *user_name = ssh_transport_client_user_name(transport);
				(void)ssh_transport_auth_password(
					transport, user_name, password_buff);
			}
			// mbedtls_platform_zeroize(password_buff, sizeof(password_buff));
			memset(password_buff, 0, sizeof(password_buff));
			password_len = 0;
			shell_bypass_ssh_transport = NULL;
			break;
		}
		password_buff[password_len++] = c;
	}
}

static void shell_bypass_ssh_shell(const struct shell *sh, uint8_t *data, size_t len)
{
	if (shell_bypass_ssh_channel == NULL) {
		return;
	}
	int written = ssh_channel_write(shell_bypass_ssh_channel, data, len);
	ARG_UNUSED(written);
	//return written == len ? 0 : -1;
}

static int ssh_client_transport_event_callback(struct ssh_transport *transport, const struct ssh_transport_event *event, void *user_data)
{
	const struct shell *sh = user_data;

	switch (event->type) {
	case SSH_TRANSPORT_EVENT_SERVICE_ACCEPTED: {
		// Authenticate
		const char *user_name = ssh_transport_client_user_name(transport);
		password_len = 0;
		shell_bypass_ssh_transport = transport;
		shell_set_bypass(sh, shell_bypass_password);
		shell_fprintf(sh, SHELL_INFO, "%s's password: ", user_name);
		return 0;

	}
	case SSH_TRANSPORT_EVENT_AUTHENTICATE_RESULT:
		if (event->authenticate_result.success) {
			// Open channel
			return ssh_transport_channel_open(transport, ssh_client_channel_event_callback, (void *)sh);
		}
		return -1;
	default:
		return -1;
	}

	return -1;

//	int res = -1;
//	const struct shell *sh = shell_backend_uart_get_ptr();
//	password_len = 0;
//	shell_set_bypass(sh, shell_bypass_password);
//	shell_fprintf(sh, SHELL_INFO, "%s's password: ", username);
//	k_sem_take(&password_sem, K_FOREVER);
//	if (password_len > 0) {
//		password_buff[password_len] = '\0';
//		res = ssh_client_auth_password(ssh_client, username, password_buff);
//	}
//	mbedtls_platform_zeroize(password_buff, sizeof(password_buff));
//	return res;
}

static int ssh_client_channel_event_callback(struct ssh_channel *channel, const struct ssh_channel_event *event, void *user_data)
{
	const struct shell *sh = user_data;

	switch (event->type) {
	case SSH_CHANNEL_EVENT_OPEN_RESULT: {
		LOG_INF("Client channel opened");
		return ssh_channel_request_shell(channel);
	}
	case SSH_CHANNEL_EVENT_REQUEST_RESULT: {
		// event->channel_request_result?
		LOG_INF("Client channel shell request complete");
		shell_bypass_ssh_channel = channel;
		shell_set_bypass(sh, shell_bypass_ssh_shell);

//		// Send some data
//		const char *data = "ls\n";
//		// const char *data = "echo \"Test stderr\" 1>&2\n";
//		uint32_t len = strlen(data);
//		int written = ssh_channel_write(channel, data, len);
//		return written == len ? 0 : -1;
	}
	case SSH_CHANNEL_EVENT_RX_DATA_READY: {
//		LOG_INF("Client channel RX data ready");
		uint8_t buff[64];
		while (true) {
			int len = ssh_channel_read(channel, buff, sizeof(buff));
			if (len <= 0) {
				return len;
			}
//			LOG_HEXDUMP_INF(buff, len, "Client channel data");
			shell_fprintf_normal(sh, "%.*s", len, buff);
		}
		break;
	}
	case SSH_CHANNEL_EVENT_TX_DATA_READY:
		//LOG_INF("Client channel TX data ready");
		break;
	case SSH_CHANNEL_EVENT_RX_STDERR_DATA_READY: {
//		LOG_INF("Client channel RX ext data ready");
		uint8_t buff[64];
		while (true) {
			int len = ssh_channel_read_stderr(channel, buff, sizeof(buff));
			if (len <= 0) {
				return len;
			}
//			LOG_HEXDUMP_INF(buff, len, "Client channel ext data");
			shell_fprintf_error(sh, "%.*s", len, buff);
		}
		break;
	}
	case SSH_CHANNEL_EVENT_EOF:
		LOG_INF("Client channel EOF");
		break;
	case SSH_CHANNEL_EVENT_CLOSED:
		LOG_INF("Client channel closed");
		shell_set_bypass(sh, NULL);
		shell_bypass_ssh_channel = NULL;
		break;
	default:
		return -1;
	}

	return 0;
}

static int cmd_start(const struct shell *sh, size_t argc, char **argv)
{
	int res;
	struct sockaddr_in addr;
	int client_inst = strtol(argv[1], NULL, 10);
	char *user_at_addr_str = argv[2];
	int host_key_index = -1;
	uint16_t port = DEFAULT_SSH_PORT;
	if (argc > 3) {
		host_key_index = strtol(argv[3], NULL, 10);
	}
	if (argc > 4) {
		port = strtol(argv[4], NULL, 10);
	}

	char *tok_state;
	const char *user_name = strtok_r(user_at_addr_str, "@", &tok_state);
	const char *addr_str = strtok_r(NULL, "", &tok_state);

	// TODO: DNS lookup, IPv4 address only for now...

	addr.sin_family = AF_INET;
	addr.sin_port = htons(port);
	res = zsock_inet_pton(AF_INET, addr_str, &addr.sin_addr);
	if (res != 1) {
		shell_error(sh, "Failed to parse address");
		return -EINVAL;
	}

	struct ssh_client *ssh_client = ssh_client_instance(client_inst);
	if (ssh_client == NULL) {
		shell_error(sh, "Failed to get SSH client instance");
		return -EINVAL;
	}

	res = ssh_client_start(
		ssh_client, user_name, &addr, host_key_index,
		ssh_client_transport_event_callback, (void *)sh);
	if (res != 0) {
		shell_error(sh, "Failed to start SSH client: %d", res);
	}

	return res;
}

static int cmd_stop(const struct shell *sh, size_t argc, char **argv)
{
	ARG_UNUSED(argc);
	int res;
	int client_inst = strtol(argv[1], NULL, 10);

	struct ssh_client *ssh_client = ssh_client_instance(client_inst);
	if (ssh_client == NULL) {
		shell_error(sh, "Failed to get SSH client instance");
		return -EINVAL;
	}

	res = ssh_client_stop(ssh_client);
	if (res != 0) {
		shell_error(sh, "Failed to stop SSH client: %d", res);
	}

	return res;
}

SHELL_STATIC_SUBCMD_SET_CREATE(
	sub_ssh,
	SHELL_CMD_ARG(start, NULL, "<inst> <user@addr> [<host-key-idx> <port>]", cmd_start, 3, 2),
	SHELL_CMD_ARG(stop, NULL, "<inst>", cmd_stop, 2, 0),
	SHELL_SUBCMD_SET_END
);

SHELL_CMD_REGISTER(ssh, &sub_ssh, "SSH client commands", NULL);
```

## src/keygen.c
```c
/*
* Copyright (c) 2024 Grant Ramsay <grant.ramsay@hotmail.com>
*
* SPDX-License-Identifier: Apache-2.0
*/

#include <zephyr/kernel.h>
#include <zephyr/net/ssh/keygen.h>
#include <zephyr/shell/shell.h>
#include <zephyr/settings/settings.h>

#include <stdio.h>
#include <stdlib.h>

#include <zephyr/logging/log.h>
LOG_MODULE_DECLARE(ssh_sample, LOG_LEVEL_INF);

#define CTRL_C 0x03

struct key_load_param {
	void *data;
	size_t len; // Max len in, actual len out
};

static uint8_t key_buf[2048];
static int pubkey_import_key_id;
static size_t pubkey_import_len;

static int settings_load_key_cb(
	const char      *key,
	size_t           len,
	settings_read_cb read_cb,
	void            *cb_arg,
	void            *param)
{
	struct key_load_param *load_param = param;
	ssize_t read = read_cb(cb_arg, load_param->data, load_param->len);
	if (read < 0) {
		return (int)read;
	}
	load_param->len = read;
	return 0;
}

static int sample_keygen_init(void)
{
	int res = settings_subsys_init();
	if (res != 0) {
		LOG_ERR("Failed to init settings subsys: %d", res);
	}
	return res;
}

static int cmd_key_gen(const struct shell *sh, size_t argc, char **argv)
{
	ARG_UNUSED(argc);
	int res;
	int key_id = strtol(argv[1], NULL, 10);
	const char *key_type_str = argv[2];
	int key_bits = strtol(argv[3], NULL, 10);
	enum ssh_host_key_type key_type;

	if (strcmp(key_type_str, "rsa") == 0) {
		key_type = SSH_HOST_KEY_TYPE_RSA;
	} else {
		shell_error(sh, "Unsupported key type: \"%s\"", key_type_str);
		return -EINVAL;
	}

	res = ssh_keygen(key_id, key_type, key_bits);
	if (res != 0) {
		shell_error(sh, "Failed to generate ssh key");
	}

	return res;
}

static int cmd_key_free(const struct shell *sh, size_t argc, char **argv)
{
	ARG_UNUSED(argc);
	int key_id = strtol(argv[1], NULL, 10);

	int res = ssh_keygen_free(key_id);
	if (res != 0) {
		shell_error(sh, "Failed to free ssh key");
	}

	return res;
}

static int cmd_key_save(const struct shell *sh, size_t argc, char **argv)
{
	ARG_UNUSED(argc);
	int res;
	int key_id = strtol(argv[1], NULL, 10);
	const char *key_type = argv[2];
	const char *key_name = argv[3];
	char setting_name[64];

	if (snprintf(setting_name, sizeof(setting_name), "ssh/keys/%s", key_name) >= sizeof(setting_name)) {
		return -EINVAL;
	}

	bool private_key;
	if (strcmp(key_type, "pub") == 0) {
		private_key = false;
	} else if (strcmp(key_type, "priv") == 0) {
		private_key = true;
	} else {
		shell_error(sh, "Invalid key type");
		return -EINVAL;
	}
	res = ssh_keygen_export(key_id, private_key, SSH_HOST_KEY_FORMAT_DER, key_buf, sizeof(key_buf));
	if (res < 0) {
		shell_error(sh, "Key export failed: %d", res);
		return res;
	}

	res = settings_save_one(setting_name, key_buf, res);
	if (res != 0) {
		LOG_ERR("Save setting failed: %d", res);
		return res;
	}
	LOG_INF("Saved %s key: %s (#%d)", key_type, key_name, key_id);

	return 0;
}

static int cmd_key_load(const struct shell *sh, size_t argc, char **argv)
{
	ARG_UNUSED(argc);
	int res;
	int key_id = strtol(argv[1], NULL, 10);
	const char *key_type = argv[2];
	const char *key_name = argv[3];
	char setting_name[64];

	if (snprintf(setting_name, sizeof(setting_name), "ssh/keys/%s", key_name) >= sizeof(setting_name)) {
		return -EINVAL;
	}

	struct key_load_param load_param = {
		.data = key_buf,
		.len = sizeof(key_buf)
	};
	res = settings_load_subtree_direct(setting_name, settings_load_key_cb, &load_param);
	if (res != 0) {
		LOG_ERR("Load setting failed: %d", res);
	}

	bool private_key;
	if (strcmp(key_type, "pub") == 0) {
		private_key = false;
	} else if (strcmp(key_type, "priv") == 0) {
		private_key = true;
	} else {
		shell_error(sh, "Invalid key type");
		return -EINVAL;
	}
	res = ssh_keygen_import(key_id, private_key, SSH_HOST_KEY_FORMAT_DER, key_buf, load_param.len);
	if (res < 0) {
		shell_error(sh, "Key import failed: %d", res);
		return res;
	}
	LOG_INF("Loaded %s key: %s (#%d)", key_type, key_name, key_id);

	return 0;
}

static int cmd_pubkey_export(const struct shell *sh, size_t argc, char **argv)
{
	ARG_UNUSED(argc);
	int res;
	int key_id = strtol(argv[1], NULL, 10);

	res = ssh_keygen_export(key_id, false, SSH_HOST_KEY_FORMAT_PEM, key_buf, sizeof(key_buf));
	if (res != 0) {
		shell_error(sh, "Key export failed: %d", res);
		return res;
	}

	shell_print(sh, "%s", key_buf);

	return 0;
}

static void shell_bypass_pubkey_import(const struct shell *sh, uint8_t *data, size_t len)
{
	shell_fprintf(sh, SHELL_NORMAL, "%.*s", len, data);

	if (pubkey_import_len + len >= sizeof(key_buf)) {
		shell_error(sh, "Key too big");
		shell_set_bypass(sh, NULL);
		return;
	}

	memcpy(&key_buf[pubkey_import_len], data, len);
	pubkey_import_len += len;

	if (key_buf[pubkey_import_len - 1] == CTRL_C) {
		key_buf[pubkey_import_len - 1] = '\0';
		int res = ssh_keygen_import(pubkey_import_key_id, false, SSH_HOST_KEY_FORMAT_PEM, key_buf, pubkey_import_len);
		if (res == 0) {
			shell_info(sh, "\nKey import success");
		} else {
			shell_error(sh, "\nKey import failed: %d", res);
		}
		shell_set_bypass(sh, NULL);
	}
}

static int cmd_pubkey_import(const struct shell *sh, size_t argc, char **argv)
{
	ARG_UNUSED(argc);
	int key_id = strtol(argv[1], NULL, 10);

	pubkey_import_key_id = key_id;
	pubkey_import_len = 0;

	shell_set_bypass(sh, shell_bypass_pubkey_import);
	shell_info(sh, "Enter public key in PEM format followed by Ctrl+C:");

	return 0;
}

SHELL_STATIC_SUBCMD_SET_CREATE(
	sub_ssh_key_pub,
	SHELL_CMD_ARG(export, NULL, "<key-id>", cmd_pubkey_export, 2, 0),
	SHELL_CMD_ARG(import, NULL, "<key-id>", cmd_pubkey_import, 2, 0),
	SHELL_SUBCMD_SET_END
);

SHELL_STATIC_SUBCMD_SET_CREATE(
	sub_ssh_key,
	SHELL_CMD_ARG(gen, NULL, "<key-id> <type> <bits>", cmd_key_gen, 4, 0),
	SHELL_CMD_ARG(free, NULL, "<key-id>", cmd_key_free, 2, 0),
	SHELL_CMD_ARG(save, NULL, "<key-id> <pub|priv> <key-name>", cmd_key_save, 4, 0),
	SHELL_CMD_ARG(load, NULL, "<key-id> <pub|priv> <key-name>", cmd_key_load, 4, 0),
	SHELL_CMD(pub, &sub_ssh_key_pub, "SSH public key commands", NULL),
	SHELL_SUBCMD_SET_END
);

SHELL_CMD_REGISTER(ssh_key, &sub_ssh_key, "SSH keygen commands", NULL);

SYS_INIT(sample_keygen_init, APPLICATION, 0);
```

## src/server.c
```c
/*
* Copyright (c) 2024 Grant Ramsay <grant.ramsay@hotmail.com>
*
* SPDX-License-Identifier: Apache-2.0
*/

#include <zephyr/kernel.h>
#include <zephyr/net/ssh/server.h>
#include <zephyr/shell/shell.h>

#include <zephyr/logging/log.h>
LOG_MODULE_DECLARE(ssh_sample, LOG_LEVEL_INF);

#define DEFAULT_SSH_PORT 22

static int ssh_server_event_callback(struct ssh_server *ssh_server, const struct ssh_server_event *event, void *user_data);
static int ssh_server_transport_event_callback(struct ssh_transport *transport, const struct ssh_transport_event *event, void *user_data);
static int ssh_server_channel_event_callback(struct ssh_channel *channel, const struct ssh_channel_event *event, void *user_data);

// TODO: Move shell stuff to an SSH shell backend
#define SHELL_SSH_DEFINE(_name)						\
	static struct shell_ssh _name##_shell_ssh;			\
	struct shell_transport _name = {				\
		.api = &shell_ssh_transport_api,			\
		.ctx = &_name##_shell_ssh				\
	}

struct shell_ssh {
	shell_transport_handler_t handler;
	void *context;
	struct ssh_channel *ssh_channel;
};

static int shell_ssh_init(const struct shell_transport *transport,
			  const void *config,
			  shell_transport_handler_t evt_handler,
			  void *context)
{
	struct shell_ssh *sh_ssh = (struct shell_ssh *)transport->ctx;

	sh_ssh->handler = evt_handler;
	sh_ssh->context = context;
	sh_ssh->ssh_channel = (void *)config;

	return 0;
}

static int shell_ssh_uninit(const struct shell_transport *transport)
{
	ARG_UNUSED(transport);
	return 0;
}

static int shell_ssh_enable(const struct shell_transport *transport, bool blocking)
{
	ARG_UNUSED(transport);
	ARG_UNUSED(blocking);
	return 0;
}

static int shell_ssh_write(const struct shell_transport *transport,
			   const void *data, size_t length, size_t *cnt)
{
	struct shell_ssh *sh_ssh = (struct shell_ssh *)transport->ctx;

	int res = ssh_channel_write(sh_ssh->ssh_channel, data, length);
	if (res < 0) {
		return res;
	}
	*cnt = res;

	return 0;
}

static int shell_ssh_read(const struct shell_transport *transport,
			  void *data, size_t length, size_t *cnt)
{
	struct shell_ssh *sh_ssh = (struct shell_ssh *)transport->ctx;

	int res = ssh_channel_read(sh_ssh->ssh_channel, data, length);
	if (res < 0) {
		return res;
	}
	*cnt = res;
	return 0;
}

const struct shell_transport_api shell_ssh_transport_api = {
	.init = shell_ssh_init,
	.uninit = shell_ssh_uninit,
	.enable = shell_ssh_enable,
	.write = shell_ssh_write,
	.read = shell_ssh_read
};

#define CONFIG_SSH_SERVER_SHELL_PROMPT "zephyr:~$ "

// TODO: Make an array of these?
SHELL_SSH_DEFINE(shell_transport_ssh);
SHELL_DEFINE(shell_ssh, CONFIG_SSH_SERVER_SHELL_PROMPT, &shell_transport_ssh,
	     CONFIG_SHELL_BACKEND_SERIAL_LOG_MESSAGE_QUEUE_SIZE,
	     CONFIG_SHELL_BACKEND_SERIAL_LOG_MESSAGE_QUEUE_TIMEOUT,
	     SHELL_FLAG_OLF_CRLF);
/*
#define CONFIG_SSH_SERVER_SHELL_COUNT 4

#define SHELL_SSH_DEFINE_ALL(n, _) \
	SHELL_SSH_DEFINE(shell_transport_ssh_##n); \
	SHELL_DEFINE(shell_ssh_##n, CONFIG_SHELL_PROMPT_SSH, &shell_transport_ssh_##n, \
		     CONFIG_SHELL_BACKEND_SERIAL_LOG_MESSAGE_QUEUE_SIZE, \
		     CONFIG_SHELL_BACKEND_SERIAL_LOG_MESSAGE_QUEUE_TIMEOUT, \
		     SHELL_FLAG_OLF_CRLF);

LISTIFY(CONFIG_SSH_SHELL_COUNT, SHELL_SSH_DEFINE_ALL, (;))

#define SHELL_SSH_REFERENCE_ALL(n, _) \
	&shell_ssh_##n

static const struct shell *const ssh_shell_instances[] = {
	LISTIFY(CONFIG_SSH_SHELL_COUNT, SHELL_SSH_REFERENCE_ALL, (,))
};
*/




static int ssh_server_event_callback(struct ssh_server *ssh_server, const struct ssh_server_event *event, void *user_data)
{
	ARG_UNUSED(ssh_server);
	ARG_UNUSED(user_data);

	switch (event->type) {
	case SSH_SERVER_EVENT_CLOSED:
		LOG_INF("Server closed");
		break;
	case SSH_SERVER_EVENT_CLIENT_CONNECTED:
		LOG_INF("Server client connected");
		break;
	case SSH_SERVER_EVENT_CLIENT_DISCONNECTED:
		LOG_INF("Server client disconnected");
		break;
	default:
		return -1;
	}

	return 0;
}

static int ssh_server_transport_event_callback(struct ssh_transport *transport, const struct ssh_transport_event *event, void *user_data)
{
	ARG_UNUSED(transport);
	ARG_UNUSED(user_data);

	switch (event->type) {
	case SSH_TRANSPORT_EVENT_CHANNEL_OPEN:
		return ssh_channel_open_result(event->channel_open.channel, true,
					       ssh_server_channel_event_callback, NULL);
	default:
		break;
	}

	return 0;
}

static int ssh_server_channel_event_callback(struct ssh_channel *channel, const struct ssh_channel_event *event, void *user_data)
{
	ARG_UNUSED(user_data);

	switch (event->type) {
	case SSH_CHANNEL_EVENT_REQUEST: {
		LOG_INF("Server channel request");
		bool success = false;
		switch (event->channel_request.type) {
		case SSH_CHANNEL_REQUEST_SHELL: {
			static const struct shell_backend_config_flags cfg_flags =
				SHELL_DEFAULT_BACKEND_CONFIG_FLAGS;
			int res = shell_init(&shell_ssh, channel, cfg_flags,
					     false, LOG_LEVEL_NONE);
			if (res != 0) {
				LOG_ERR("shell_init error");
			}
			success = true;
			break;
		}
		case SSH_CHANNEL_REQUEST_PSEUDO_TERMINAL:
		case SSH_CHANNEL_REQUEST_ENV_VAR:
		case SSH_CHANNEL_REQUEST_WINDOW_CHANGE:
			// Pretend like we support these for now
			success = true;
			break;
		default:
			break;
		}
		if (event->channel_request.want_reply) {
			return ssh_channel_request_result(channel, success);
		}
		return 0;
	}
	case SSH_CHANNEL_EVENT_RX_DATA_READY: {
		struct shell_ssh *sh_ssh = &shell_transport_ssh_shell_ssh;
		sh_ssh->handler(SHELL_TRANSPORT_EVT_RX_RDY, sh_ssh->context);
		break;
	}
	case SSH_CHANNEL_EVENT_TX_DATA_READY: {
		struct shell_ssh *sh_ssh = &shell_transport_ssh_shell_ssh;
		sh_ssh->handler(SHELL_TRANSPORT_EVT_TX_RDY, sh_ssh->context);
		break;
	}
	case SSH_CHANNEL_EVENT_RX_STDERR_DATA_READY:
		LOG_INF("Server channel RX ext data ready");
		break;
	case SSH_CHANNEL_EVENT_EOF:
		LOG_INF("Server channel EOF");
		break;
	case SSH_CHANNEL_EVENT_CLOSED:
		LOG_INF("Server channel closed");
		shell_uninit(&shell_ssh, NULL);
		break;
	default:
		return -1;
	}

	return 0;
}

static int cmd_start(const struct shell *sh, size_t argc, char **argv)
{
	int res;
	struct sockaddr_in bind_addr;
	int server_inst = strtol(argv[1], NULL, 10);
	const char *bind_addr_str = argv[2];
	int host_key_index = strtol(argv[3], NULL, 10);
	const char *password = argv[4];
	int port = DEFAULT_SSH_PORT;
	int authorized_keys_index[CONFIG_SSH_MAX_HOST_KEYS];
	int authorized_keys_count = argc > 6 ? MIN(argc - 6, ARRAY_SIZE(authorized_keys_index)) : 0;

	if (argc > 5) {
		port = strtol(argv[5], NULL, 10);
	}

	for (int i = 0; i < authorized_keys_count; i++) {
		authorized_keys_index[i] = strtol(argv[6 + i], NULL, 10);
	}

	// TODO: DNS lookup, IPv4 address only for now...

	bind_addr.sin_family = AF_INET;
	bind_addr.sin_port = htons(port);
	res = zsock_inet_pton(AF_INET, bind_addr_str, &bind_addr.sin_addr);
	if (res != 1) {
		shell_error(sh, "Failed to parse bind address");
		return -EINVAL;
	}

	struct ssh_server *ssh_server = ssh_server_instance(server_inst);
	if (ssh_server == NULL) {
		shell_error(sh, "Failed to get SSH server instance");
		return -EINVAL;
	}

	res = ssh_server_start(
		ssh_server, &bind_addr, host_key_index, password,
		authorized_keys_index, authorized_keys_count,
		ssh_server_event_callback, ssh_server_transport_event_callback, NULL);
	if (res != 0) {
		shell_error(sh, "Failed to start SSH server: %d", res);
	}

	return res;
}

static int cmd_stop(const struct shell *sh, size_t argc, char **argv)
{
	ARG_UNUSED(argc);
	int res;
	int server_inst = strtol(argv[1], NULL, 10);

	struct ssh_server *ssh_server = ssh_server_instance(server_inst);
	if (ssh_server == NULL) {
		shell_error(sh, "Failed to get SSH server instance");
		return -EINVAL;
	}

	res = ssh_server_stop(ssh_server);
	if (res != 0) {
		shell_error(sh, "Failed to stop SSH server: %d", res);
	}

	return res;
}

SHELL_STATIC_SUBCMD_SET_CREATE(
	sub_sshd,
	SHELL_CMD_ARG(start, NULL,
		      "<inst> <bind-addr> <host-key-idx> <password> [<port> <auth-key-idx> <auth-key-idx> ...]",
		      cmd_start, 5, 1 + CONFIG_SSH_MAX_HOST_KEYS),
	SHELL_CMD_ARG(stop, NULL, "<inst>", cmd_stop, 2, 0),
	SHELL_SUBCMD_SET_END
);

SHELL_CMD_REGISTER(sshd, &sub_sshd, "SSH server commands", NULL);
```
